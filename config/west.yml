## config/west.yml
```yaml
manifest:
  remotes:
    - name: zmkfirmware
      url-base: https://github.com/zmkfirmware
      # Additional modules containing boards/shields/custom code can be listed here as well.
      # See:
      # - https://zmk.dev/docs/features/modules
      # - https://docs.zephyrproject.org/3.5.0/develop/west/manifest.html#projects
    - name: gpeye
      url-base: https://github.com/GPeye
    - name: nice-view-gifs-o4q4o
      url-base: https://github.com/nice-view-gifs-o4q4o
  projects:
    - name: eyelash_sofle
      url: https://github.com/a741725193/zmk-sofle
      revision: refactor
    # - name: mario-peripheral-animation
    #  remote: gpeye
    #  revision: main
    - name: nice-view-gifs-o4q4o                 
      remote: nice-view-gifs-o4q4o       
      revision: bongo-cat                 
    - name: zmk
      remote: zmkfirmware
      revision: main
      import: app/west.yml
  self:
    path: config
```
